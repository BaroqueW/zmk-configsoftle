## boards/arm/sofle_choc_pro/board.yml
```yaml
boards:
  - name: sofle_choc_pro_left
    vendor: baroquew
    socs:
      - name: nrf52840

  - name: sofle_choc_pro_right
    vendor: baroquew
    socs:
      - name: nrf52840
```

## config/west.yml
```yaml
manifest:
  remotes:
    - name: zmkfirmware
      url-base: https://github.com/zmkfirmware
    # Additional modules containing boards/shields/custom code can be listed here as well
    # See https://docs.zephyrproject.org/3.2.0/develop/west/manifest.html#projects
    - name: yanshay
      url-base: https://github.com/yanshay
        # support nice_oled and nice_epaper
    - name: baroquew
      url-base: https://github.com/BaroqueW
    - name: ssbb
      url-base: https://github.com/ssbb
  projects:
    - name: zmk
      remote: zmkfirmware
      revision: main
      import: app/west.yml
    - name: zmk-nodefree-config
      remote: yanshay
      revision: main
  self:
    path: config
```
